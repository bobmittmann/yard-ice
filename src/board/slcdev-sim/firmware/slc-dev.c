#include <stdio.h>
#include <stdlib.h>
#include <string.h>

#include <sys/delay.h>
#include <sys/serial.h>
#include <sys/dcclog.h>
#include <sys/shell.h>

#include <thinkos.h>

#include "config.h"
#include "board.h"
#include "isink.h"
#include "slcdev.h"
#include "serdrv.h"
#include "xmodem.h"
#include "bacnet_ptp.h"

#define VERSION_NUM "0.9"
#define VERSION_DATE "Jul, 2015"

extern const struct shell_cmd cmd_tab[];

const char version_str[] = "SLC Device Simulator " \
							VERSION_NUM " - " VERSION_DATE;
const char copyright_str[] = "(c) Copyright 2014-2015 - Mircom Group";


uint32_t __attribute__((aligned(8))) io_event_stack[24];
uint32_t __attribute__((aligned(8))) sim_event_stack[96];

#if THINKOS_STDERR_FAULT_DUMP
const struct file stm32_uart_file = {
	.data = STM32_USART2, 
	.op = &stm32_usart_fops 
};
#endif

int js(FILE * f, char * script, unsigned int len);

void slcdev_shell(FILE * f) 
{
	char hist_buf[SIZEOF_CMD_HISTORY + SHELL_HISTORY_MAX * SHELL_LINE_MAX];
	char line[SHELL_LINE_MAX];
	struct cmd_history * history;
	int ret = 0;

	DCC_LOG(LOG_MSG, "history_init()");

	history = history_init(hist_buf, sizeof(hist_buf), SHELL_LINE_MAX);

	DCC_LOG(LOG_MSG, "shell_greeting()");
	fprintf(f, "\n%s\n%s\n\n", version_str, copyright_str);

	/* start a shell on the serial TTY */
	do {
		char * stat;
		char * cp;

		DCC_LOG(LOG_MSG, "shell_prompt()!");
		fprintf(f, "[DEV]$ ");

		if (history_readline(history, f, line, SHELL_LINE_MAX) == NULL)
			continue;

		if ((cp = shell_stripline(line)) == NULL)
			continue;

		DCC_LOG(LOG_MSG, "history_add()");
		history_add(history, cp);

		DCC_LOGSTR(LOG_MSG, "cp=\"%s\"", cp);

		/* try to get a command from the line */
		if (cmd_lookup(cmd_tab, cp) == NULL) {
			/* try to interpret a javascript code instead */
			DCC_LOG(LOG_MSG, "js...");
			js(f, cp, strlen(cp));
			DCC_LOG(LOG_MSG, "done...");
			continue;
		}

		DCC_LOG(LOG_TRACE, "shell command ...");

		ret = 0;

		while ((stat = cmd_get_next(&cp)) != NULL) {
			struct shell_cmd * cmd;

			if ((cmd = cmd_lookup(cmd_tab, stat)) == NULL) {
				fprintf(f, "Command not found!\n");
				break;
			}

			ret = cmd_exec(f, cmd, stat);

			if ((ret < 0) && (ret !=  SHELL_ABORT)) {
				fprintf(f, "Error: %d\n", -ret);
				break;
			}

		}
	} while (ret != SHELL_ABORT); 
}

int __attribute__((noreturn)) main(int argc, char ** argv)
{
	struct serdrv * sdrv;
	FILE * f;

	DCC_LOG_INIT();
	DCC_LOG_CONNECT();

	DCC_LOG(LOG_INFO, "1. cm3_udelay_calibrate()");
	/* calibrate the delay loop for udelay() and friends. */
	cm3_udelay_calibrate();

	DCC_LOG(LOG_INFO, "2. thinkos_init()");
	/* initialize the operating system */
	thinkos_init(THINKOS_OPT_PRIORITY(2) | THINKOS_OPT_ID(2));

#ifndef DEBUG
	/* wait for the device to charge a little bit before enabling
	   peripherals */
	thinkos_sleep(2000);
#endif

	DCC_LOG(LOG_INFO, "4. io_init()");
	/* initialize IO pins */
	io_init();

	DCC_LOG(LOG_INFO, "5. isink_init()");

	/* enable the current sink driver. This will start the negative 
	   voltage power supply */
	isink_init();

	/* configure the current sink driver to default values */
	isink_mode_set(ISINK_CURRENT_NOM | ISINK_RATE_FAST);
	/* dummy pulse to reet the timer */
	isink_pulse(2, 0);

	/* create a thread to handle IO events like switches and
	   address selection. This thread also controls the LEDs flashing. */
	thinkos_thread_create((void *)io_event_task, (void *)NULL,
						  io_event_stack, sizeof(io_event_stack) |
						  THINKOS_OPT_PRIORITY(1) | THINKOS_OPT_ID(1));

	DCC_LOG(LOG_TRACE, "6. lamp_test()");
	/* perform a lamp test while the current sink 
	   negative voltage stabilizes */
	lamp_test();

	DCC_LOG(LOG_TRACE, "7. slcdev_init()");
	/* initilice the SLC device driver */
	slcdev_init();

	DCC_LOG(LOG_TRACE, "8. const_strbuf_init()");
	/* initialize constat string buffer */
	const_strbuf_init();

	DCC_LOG(LOG_TRACE, "9. device_db_init()");
	/* initializes database */
	device_db_init();

	DCC_LOG(LOG_TRACE, "10. config_load()");
	/* load configuration */
	config_load();

	DCC_LOGSTR(LOG_TRACE, "\"%s\"", version_str);

	/* create a thread to handle simulation events. This is the 
	   actual simulation loop. The events are generated by the 
	   SLC device driver according to the configuration devices which 
	   are current enabled. */
	thinkos_thread_create((void *)sim_event_task, (void *)NULL,
						  sim_event_stack, sizeof(sim_event_stack) | 
						  THINKOS_OPT_PRIORITY(0) | THINKOS_OPT_ID(0));

	/* initialize serial driver */
	sdrv = serdrv_init(115200);
//	sdrv = serdrv_init(57600);

	/* initialize serial TTY driver */
	f = serdrv_tty_fopen(sdrv);

	/* initialize STDIO */
	stdout = f;
#if THINKOS_STDERR_FAULT_DUMP
	stderr = (struct file *)&stm32_uart_file;
#else
	stderr = f;
#endif

	DCC_LOG1(LOG_TRACE, "f=%08x", f);
	fprintf(f, "\n%s\n%s\n\n", version_str, copyright_str);

	/* start simulation */
	thinkos_ev_raise(SLCDEV_DRV_EV, SLC_EV_SIM_START);

	/* main loop */
	for (;;) {
		DCC_LOG(LOG_TRACE, "Console shell!");
		slcdev_shell(f); 

//		thinkos_sleep(1000);

		/* BACnet protocol... */
//		DCC_LOG(LOG_WARNING, "BACnet Data Link Connection!");
//		bacnet_ptp(sdrv);
	}
}

